## sdkconfig.defaults
```kconfig
####################################################################################
# Project uses: ESP32-WROVER-E
# Datasheet: https://www.espressif.com/sites/default/files/documentation/esp32-wrover_datasheet_en.pdf
####################################################################################

CONFIG_IDF_CMAKE=y
CONFIG_IDF_TARGET="esp32"
CONFIG_IDF_TARGET_ESP32=y

#
# SDK tool configuration
#
# end of SDK tool configuration

#
# Build type
#
# end of Build type

#
# Application manager
#
# end of Application manager

#
# Bootloader config
#
# end of Bootloader config

#
# Security features
#
# end of Security features

#
# Serial flasher config
#
CONFIG_ESPTOOLPY_FLASHSIZE_4MB=y
CONFIG_ESPTOOLPY_FLASHSIZE="4MB"
# end of Serial flasher config

#
# Partition Table
#
# end of Partition Table

#
# Compiler options
#
CONFIG_COMPILER_STACK_CHECK_MODE_STRONG=y
CONFIG_COMPILER_STACK_CHECK=y
# end of Compiler options

#
# Component config
#

#
# Application Level Tracing
#
# end of Application Level Tracing

#
# ESP-ASIO
#
# end of ESP-ASIO

#
# Bluetooth
#
# CONFIG_BT_ENABLED is not set
# end of Bluetooth

#
# CoAP Configuration
#
# end of CoAP Configuration

#
# Driver configurations
#

#
# ADC configuration
#
# end of ADC configuration

#
# SPI configuration
#
CONFIG_SPI_MASTER_ISR_IN_IRAM=y
CONFIG_SPI_SLAVE_ISR_IN_IRAM=y
# end of SPI configuration

#
# TWAI configuration
#
# end of TWAI configuration

#
# UART configuration
#
# end of UART configuration

#
# RTCIO configuration
#
# end of RTCIO configuration

#
# GPIO Configuration
#
# end of GPIO Configuration
# end of Driver configurations

#
# eFuse Bit Manager
#
# end of eFuse Bit Manager

#
# ESP-TLS
#
# end of ESP-TLS

#
# ESP32-specific
#

#
# SPI RAM config
#

#
# SPIRAM cache workaround debugging
#
# end of SPIRAM cache workaround debugging

#
# PSRAM clock and cs IO for ESP32-DOWD
#
# end of PSRAM clock and cs IO for ESP32-DOWD

#
# PSRAM clock and cs IO for ESP32-D2WD
#
# end of PSRAM clock and cs IO for ESP32-D2WD

#
# PSRAM clock and cs IO for ESP32-PICO
#
# end of PSRAM clock and cs IO for ESP32-PICO

# CONFIG_SPIRAM_CUSTOM_SPIWP_SD3_PIN is not set
# CONFIG_SPIRAM_2T_MODE is not set
# end of SPI RAM config

# end of ESP32-specific

#
# ADC-Calibration
#
# end of ADC-Calibration

#
# Common ESP-related
#
CONFIG_ESP_MAIN_TASK_STACK_SIZE=2048
# end of Common ESP-related

#
# Ethernet
#
# end of Ethernet

#
# Event Loop Library
#
# end of Event Loop Library

#
# GDB Stub
#
# end of GDB Stub

#
# ESP HTTP client
#
# end of ESP HTTP client

#
# HTTP Server
#
# end of HTTP Server

#
# ESP HTTPS OTA
#
# end of ESP HTTPS OTA

#
# ESP HTTPS server
#
# end of ESP HTTPS server

#
# ESP NETIF Adapter
#
# end of ESP NETIF Adapter

#
# Power Management
#
# end of Power Management

#
# ESP System Settings
#

#
# Memory protection
#
# end of Memory protection
# end of ESP System Settings

#
# High resolution timer (esp_timer)
#
# end of High resolution timer (esp_timer)

#
# Wi-Fi
#
# end of Wi-Fi

#
# PHY
#
# end of PHY

#
# Core dump
#
# end of Core dump

#
# FAT Filesystem support
#
# end of FAT Filesystem support

#
# Modbus configuration
#
# end of Modbus configuration

#
# FreeRTOS
#
# end of FreeRTOS

#
# Heap memory debugging
#
CONFIG_HEAP_POISONING_COMPREHENSIVE=y
CONFIG_HEAP_TRACING_OFF=y
CONFIG_HEAP_TASK_TRACKING=y
# end of Heap memory debugging

#
# jsmn
#
# end of jsmn

#
# libsodium
#
# end of libsodium

#
# Log output
#
# end of Log output

#
# LWIP
#

#
# DHCP server
#
# end of DHCP server

#
# TCP
#
# end of TCP

#
# UDP
#
# end of UDP

#
# Checksums
#
# end of Checksums

#
# ICMP
#
# end of ICMP

#
# LWIP RAW API
#
# end of LWIP RAW API

#
# SNTP
#
# end of SNTP

#
# Hooks
#
# end of Hooks

# end of LWIP

#
# mbedTLS
#

#
# Certificate Bundle
#
# CONFIG_MBEDTLS_CERTIFICATE_BUNDLE is not set
# end of Certificate Bundle

#
# TLS Key Exchange Methods
#
# end of TLS Key Exchange Methods

#
# Symmetric Ciphers
#
# end of Symmetric Ciphers


#
# Certificates
#
# end of Certificates

# end of mbedTLS

#
# mDNS
#
# end of mDNS

#
# ESP-MQTT Configurations
#
# end of ESP-MQTT Configurations

#
# Newlib
#
# end of Newlib

#
# NVS
#
# end of NVS

#
# OpenSSL
#
# end of OpenSSL

#
# PThreads
#
# end of PThreads

#
# SPI Flash driver
#

#
# Auto-detect flash chips
#
# end of Auto-detect flash chips

# end of SPI Flash driver

#
# SPIFFS Configuration
#

#
# SPIFFS Cache Configuration
#
# end of SPIFFS Cache Configuration

#
# Debug Configuration
#
# end of Debug Configuration
# end of SPIFFS Configuration

#
# TCP Transport
#
# end of TCP Transport

#
# TinyUSB
#
# end of TinyUSB

#
# Unity unit testing library
#
# end of Unity unit testing library

#
# Virtual file system
#

#
# Host File System I/O (Semihosting)
#
# end of Host File System I/O (Semihosting)
# end of Virtual file system

#
# Wear Levelling
#
# end of Wear Levelling

#
# Wi-Fi Provisioning Manager
#
# end of Wi-Fi Provisioning Manager

#
# Supplicant
#
# end of Supplicant

#
# lv_demos configuration
#
CONFIG_LV_USE_DEMO_WIDGETS=y
# end of lv_demos configuration

#
# LVGL configuration
#

#
# Color settings
#
CONFIG_LV_COLOR_16_SWAP=y
# end of Color settings

#
# Memory settings
#
CONFIG_LV_MEM_SIZE_KILOBYTES=600
# end of Memory settings

#
# HAL Settings
#
# end of HAL Settings

#
# Feature configuration
#

#
# Drawing
#
# end of Drawing

#
# GPU
#
# end of GPU

#
# Logging
#
# end of Logging

#
# Asserts
#
# end of Asserts

#
# Others
#
# end of Others

#
# Compiler settings
#
# end of Compiler settings

# end of Feature configuration

#
# Font usage
#

#
# Enable built-in fonts
#
CONFIG_LV_FONT_MONTSERRAT_12=y
CONFIG_LV_FONT_MONTSERRAT_14=y
CONFIG_LV_FONT_MONTSERRAT_16=y
# end of Enable built-in fonts

CONFIG_LV_FONT_DEFAULT_MONTSERRAT_12=y
# end of Font usage

#
# Themes
#
# end of Themes

#
# Text Settings
#
# end of Text Settings

#
# Widget usage
#
CONFIG_LV_USE_ARC=y
CONFIG_LV_USE_BAR=y
CONFIG_LV_USE_BTN=y
CONFIG_LV_USE_BTNMATRIX=y
CONFIG_LV_USE_CANVAS=y
CONFIG_LV_USE_CHECKBOX=y
CONFIG_LV_USE_CHART=y
CONFIG_LV_USE_DROPDOWN=y
CONFIG_LV_USE_IMG=y
CONFIG_LV_USE_LABEL=y
# CONFIG_LV_LABEL_TEXT_SEL is not set
# CONFIG_LV_LABEL_LONG_TXT_HINT is not set
CONFIG_LV_USE_LINE=y
CONFIG_LV_USE_METER=y
CONFIG_LV_USE_ROLLER=y
CONFIG_LV_ROLLER_INF_PAGES=7
CONFIG_LV_USE_SLIDER=y
CONFIG_LV_USE_SWITCH=y
CONFIG_LV_USE_TEXTAREA=y
CONFIG_LV_TEXTAREA_DEF_PWN_SHOW_TIME=1500
CONFIG_LV_USE_TABLE=y
# end of Widget usage

#
# Extra components
#
# end of Extra components

#
# Layouts
#
# end of Layouts
# end of LVGL configuration

#
# LVGL ESP Drivers
#

#
# LVGL TFT Display controller
#
CONFIG_LV_PREDEFINED_DISPLAY_NONE=y
CONFIG_LV_TFT_DISPLAY_CONTROLLER_ILI9341=y
CONFIG_LV_TFT_DISPLAY_PROTOCOL_SPI=y
CONFIG_LV_DISPLAY_ORIENTATION_LANDSCAPE=y
CONFIG_LV_DISPLAY_ORIENTATION=2
CONFIG_LV_PREDEFINED_PINS_NONE=y
CONFIG_LV_TFT_DISPLAY_USER_CONTROLLER_ILI9341=y
CONFIG_CUSTOM_DISPLAY_BUFFER_SIZE=y
CONFIG_CUSTOM_DISPLAY_BUFFER_BYTES=8192
CONFIG_LV_TFT_DISPLAY_SPI_VSPI=y
CONFIG_LV_TFT_DISPLAY_SPI_TRANS_MODE_SIO=y
CONFIG_LV_TFT_DISPLAY_SPI_FULL_DUPLEX=y
CONFIG_LV_TFT_CUSTOM_SPI_CLK_DIVIDER=2

#
# Display Pin Assignments
#
CONFIG_LV_DISP_SPI_MOSI=19
CONFIG_LV_DISPLAY_USE_SPI_MISO=y
CONFIG_LV_DISP_SPI_MISO=4
CONFIG_LV_DISP_SPI_INPUT_DELAY_NS=0
CONFIG_LV_DISP_SPI_CLK=2
CONFIG_LV_DISPLAY_USE_SPI_CS=y
CONFIG_LV_DISP_SPI_CS=5
CONFIG_LV_DISPLAY_USE_DC=y
CONFIG_LV_DISP_PIN_DC=10
CONFIG_LV_DISP_USE_RST=y
CONFIG_LV_DISP_PIN_RST=18
CONFIG_LV_DISP_PIN_BUSY=35
# end of Display Pin Assignments

# CONFIG_LV_DISP_BACKLIGHT_OFF is not set
CONFIG_LV_DISP_BACKLIGHT_SWITCH=y
# CONFIG_LV_DISP_BACKLIGHT_PWM is not set
CONFIG_LV_BACKLIGHT_ACTIVE_LVL=y
CONFIG_LV_DISP_PIN_BCKL=4
CONFIG_LV_I2C_DISPLAY_PORT=0
# end of LVGL TFT Display controller

#
# LVGL Touch controller
#
CONFIG_LV_TOUCH_CONTROLLER=2
CONFIG_LV_TOUCH_CONTROLLER_FT6X06=y
CONFIG_LV_I2C_TOUCH=y

#
# Touchpanel Configuration (FT6X06)
#
# end of Touchpanel Configuration (FT6X06)

CONFIG_LV_I2C_TOUCH_PORT_0=y
CONFIG_LV_I2C_TOUCH_PORT=0
# end of LVGL Touch controller
# end of LVGL ESP Drivers

#
# I2C Port Settings
#

#
# I2C Port 0
#
CONFIG_I2C_MANAGER_0_ENABLED=y
CONFIG_I2C_MANAGER_0_SDA=22
CONFIG_I2C_MANAGER_0_SCL=23
CONFIG_I2C_MANAGER_0_FREQ_HZ=400000
CONFIG_I2C_MANAGER_0_TIMEOUT=20
CONFIG_I2C_MANAGER_0_LOCK_TIMEOUT=50
CONFIG_I2C_MANAGER_0_PULLUPS=n
# end of I2C Port 0

#
# I2C Port 1
#
# end of I2C Port 1
# end of I2C Port Settings
# end of Component config

#
# Compatibility options
#
# end of Compatibility options

# Deprecated options for backward compatibility
# End of deprecated options
```
